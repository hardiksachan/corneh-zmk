## boards/shields/acorn/Kconfig.shield
```kconfig
# Copyright (c) 2020 The ZMK Contributors
# SPDX-License-Identifier: MIT

config SHIELD_ACORN_CENTRAL_LEFT
    def_bool $(shields_list_contains,acorn_central_left)

config SHIELD_ACORN_PERIPHERAL_RIGHT
    def_bool $(shields_list_contains,acorn_peripheral_right)
```
